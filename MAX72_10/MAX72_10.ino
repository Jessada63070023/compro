/* UNO */
// Use the MD_MAX72XX library to Display a Daft Punk LED Helmet
//
// If RUN_DEMO is set to zero the display cycles changes triggered by a switch on
// the MODE_SWITCH pin. This can be substituted for any trigger as implemented 
// by the helmet wearer. 
// If RUN_DEMO is set to 1 the sketch will cycle each element of the display every 
// DEMO_DELAY seconds, without the need for a switch.
//
// Uses the MD_Keyswitch library found at http://arduinocode.codeplex.com/releases

#include <D:\@CLOUD\GDrive\Arduino\D1\MAX72_10\MD_MAX72xx.h>

// --------------------
// MD_MAX72xx hardware definitions and object
// Define the number of devices we have in the chain and the hardware interface
// NOTE: These pin numbers will probably not work with your hardware and may 
// need to be adapted
//
#define	MAX_DEVICES	8
#define	CLK_PIN		13  // 13 or SCK
#define	CS_PIN		12  // 2(tx1/09/GPI02จ IS OK TOO, or SS
#define DATA_PIN  11 // 11 or MOSI

MD_MAX72XX mx = MD_MAX72XX(CS_PIN, MAX_DEVICES);                      // SPI hardware interface

int TD_max_row = 16;
int TD_max_col = (MAX_DEVICES/8)*32;
int TD_max_char_row1 = 10;
int TD_max_char_row2 = 12;
int TD_max_char_col = 16;
int TD_normal_row = 3;
int TD_start_not_thai_char = 33;
int TD_start_thai_char = 161;
int TD_gap_pixel = 1;

// thai over 
const int char_char_x1 = 12;
int char_x1[char_char_x1] = { 209,212,213,214,215,232,233,234,235,236,237,238 };

// thai under
const int char_char_x2 = 2;
int char_x2[char_char_x2] = { 216,217 };

unsigned int char_data1[93][10] = {
  {0,0,0,0,0,0,0,0,0,0},         // 33 !
  {0,0,0,0,0,0,0,0,0,0},         // 34 "
  {0,0,0,0,0,0,0,0,0,0},         // 35 #
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  {0,0,0,0,0,0,0,0,0,0},         // 125 }
};

unsigned int char_data2[78][12] = {
  {0,0,0,64512,52224,19456,52224,52224,52224,52224,0,0},         // 161 ก
  {0,0,0,60416,60416,27648,27648,27648,27648,30720,0,0},         // 162 ข
  {0,0,0,44032,60416,27648,27648,27648,27648,30720,0,0},         // 163 ฃ
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  {0,32768,0,0,0,0,0,0,0,0,0,0},         // 218 ฺ
  {}, 
  {}, 
  {}, 
  {}, 
  {}, 
  {0,0,0,49152,49152,49152,49152,49152,49152,49152,0,0},         // 224 เ
  {0,0,0,27648,27648,27648,27648,27648,27648,27648,0,0},         // 225 แ
  {28672,57344,24576,24576,24576,24576,24576,24576,24576,24576,0,0},         // 226 โ
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  {3072,3072,0,0,0,0,0,0,0,0,0,0},         // 238 ๎
};


void TD_setPoint(uint16_t r, uint16_t c, bool state)
{
  uint16_t nr = 0;
  uint16_t nc = 0;

  if (r<=0 || r>TD_max_row) return;
  if (c<=0 || c>TD_max_col) return;
  
  if (r>8) {
    r=r-8;
    nc=TD_max_col;
  }
  nr = r-1;
  nc = nc+TD_max_col-c;
  
  mx.MysetPoint(nr, nc, state);
}

char * TD_IntToBin(unsigned int p_ui)
{
  static char ret[17];        // need to change if expand font width

  for (int i=0; i<TD_max_char_col; i++) ret[TD_max_char_col-1-i]='0'+((p_ui&(1<<i))>0);
  ret[TD_max_char_col] ='\0';

  return ret;
}

void TD_SerialShowBinChar2(int p_idx)
{
  String c;

  Serial.println(p_idx);
  for (int i=0; i<TD_max_char_row2; i++) {
    c = TD_IntToBin(char_data2[p_idx][i]);
    c.replace("1","X");
    c.replace("0"," ");
    Serial.println(c);
  }    
  Serial.println("");
}    

int TD_IsX1(int idx)
{
  int ret=0;

  for (int i=0; i<char_char_x1; i++) {
    if (char_x1[i]==idx) {
      ret=1;
      break;
    }
  }

  return ret;
}

int TD_IsX2(int idx)
{
  int ret=0;

  for (int i=0; i<char_char_x2; i++) {
    if (char_x2[i]==idx) {
      ret=1;
      break;
    }
  }

  return ret;
}

void TD_WriteChar(int p_r, int p_c, int p_idx)
{
  char * c;

  // not thai
  if (p_idx<TD_start_thai_char) {
    p_idx=p_idx-TD_start_not_thai_char;
    //TD_SerialShowBinChar2(p_idx);
    
    for (int i=0; i<TD_max_char_row1; i++) {
      c =  TD_IntToBin(char_data1[p_idx][i]);
      for (int j=0; j<TD_max_char_col; j++)
        if (c[j]=='1') {
          TD_setPoint(p_r+i, p_c+j, true);
        }
    }
  // thai
  } else {
    p_idx=p_idx-TD_start_thai_char;
    //TD_SerialShowBinChar2(p_idx);
    
    for (int i=0; i<TD_max_char_row2; i++) {
      c =  TD_IntToBin(char_data2[p_idx][i]);
      for (int j=0; j<TD_max_char_col; j++)
        if (c[j]=='1') {
          TD_setPoint(p_r+i, p_c+j, true);
        }
    }
  }
  
}

int TD_CharWidth(int p_idx)
{
  char * c;
  int w=0;

  if (p_idx<TD_start_thai_char) {
    p_idx=p_idx-TD_start_not_thai_char;

    for (int i=0; i<TD_max_char_row1; i++) {
      c =  TD_IntToBin(char_data1[p_idx][i]);
      for (int j=0; j<TD_max_char_col; j++)
        if (c[j]=='1') {
          if (j>=w) w=j;
        }
    }

  // thai
  } else {
    p_idx=p_idx-TD_start_thai_char;

    for (int i=0; i<TD_max_char_row2; i++) {
      c =  TD_IntToBin(char_data2[p_idx][i]);
      for (int j=0; j<TD_max_char_col; j++)
        if (c[j]=='1') {
          if (j>=w) w=j;
        }
    }
  }

  return w+1;
}

int TD_Char2Width(int p_idx)
{
  char * c;
  int w=0;

  for (int i=0; i<TD_max_char_row2; i++) {
    c =  TD_IntToBin(char_data2[p_idx][i]);
    for (int j=0; j<TD_max_char_col; j++)
      if (c[j]=='1') {
        if (j>=w) w=j;
      }
  }

  return w+1;
}

void TD_WriteText(int p_r, int p_c, String p_text)
{
  char c1;
  char c2;
  int w=0;
  int idx=0;
  int normal;

  mx.clear();  
  for (int i=0; i<p_text.length(); i++) {
    c1 = p_text[i];
    // E0 224 Thai
    if ((int)c1==224) {
      c1=p_text[i+1];
      c2=p_text[i+2];
      // B8,81(129)  ก - ฮ 
      if ((int)c1==184 && ((int)c2+32)>=161 && ((int)c2+32)<=207) {
        // ก 81 = 129 --> +32 --> 161
         idx=(int)c2+32;
      }
      // B8,B0(176)  สระ
      if ((int)c1==184 && ((int)c2+32)>=208 && ((int)c2+32)<=218) {
        // ะ B0 = 176 --> +32 --> 208
         idx=(int)c2+32;
      }
      // B9,80(128)  สระ
      if ((int)c1==185 && ((int)c2+96)>=224 && ((int)c2+96)<=231) {
        // เ 80 = 176 --> +96 --> 224
         idx=(int)c2+96;
      }
      // B9,B0(136)  วรรณยุก
      if ((int)c1==185 && ((int)c2+96)>=232 && ((int)c2+96)<=238) {
        // ่ 88 = 136 --> +96 --> 208
         idx=(int)c2+96;
      }
      i=i+2;
    } else {
      idx=(int)c1;
    }

    normal=1;
    // thai over
    if (TD_IsX1(idx)==1) {
      w=TD_CharWidth(idx);
      TD_WriteChar(p_r-2,p_c-(w+TD_gap_pixel),idx);
      normal=0;
    } 
    // thai under
    if (TD_IsX2(idx)==1) {
      w=TD_CharWidth(idx);
      TD_WriteChar(p_r+10,p_c-(w+TD_gap_pixel),idx);
      normal=0;
    } 
    if (normal==1) {
      switch (idx) {
        case 32:  // space
          p_c=p_c+8;
          break;
        case 211: // ำ
          w=TD_CharWidth(idx);
          TD_WriteChar(p_r,p_c-(3+TD_gap_pixel),idx);
          p_c=p_c-3+w+TD_gap_pixel;
          break;
        default:
          TD_WriteChar(p_r,p_c,idx);
          w=TD_CharWidth(idx);
          p_c=p_c+w+TD_gap_pixel;
          break;
      }
    }
  }
  mx.MyflushBufferAll();
}

void TD_Text(String p_text)
{
  TD_WriteText(TD_normal_row,1,p_text);
}  

void TD_ScrollText(String p_text, int p_n)
{
  int c;
  int n;

  for (int i=TD_max_col; i>=p_n*-8; i--) {
    TD_WriteText(TD_normal_row,i,p_text);
    
    delay(30);
  }
}  

void setup()
{
  mx.begin();
  Serial.begin(9600);

//  String t;
//  t = "เแโใไ";
//  TD_Text(t);
  
}

void loop() 
{

  String t;
  
//  t = "การทดสอบ";
//  TD_ScrollText(t,10);
//  t = "กขฃคฅฆงจฉชซฌญฎฏฐฑฒณดตถทธนบปผฝพฟภมยรฤลฦวศษสหฬอฮ";
//  TD_ScrollText(t,46);
//  t = "ABCDEFGHIJKLMNOPQRSTUVWXYZ";
//  TD_ScrollText(t,28);
//
//  t = "ภาษาไทย PASA UNGKID OK";
//  TD_ScrollText(t,25);
//  t = "เสียงล่ำลือ เสียงล่ำลือ ถึงข่าวดี";
//  TD_ScrollText(t,25);
//  t = "D ไหม  D ไหม  D ไหม  หา    ดี   ฮ่า";
//  TD_ScrollText(t,35);

  t = "สวัสดีครับ คลิปนี้พูดเรื่องการใช้ DOT MATRIX แสดงภาษาไทย";
  TD_ScrollText(t,45);

//  t = "THIS IS DEMO การทดสอบ";
//  TD_ScrollText(t,25);
  
}

